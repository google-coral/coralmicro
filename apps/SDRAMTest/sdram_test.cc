#include "third_party/freertos_kernel/include/FreeRTOS.h"
#include "third_party/freertos_kernel/include/task.h"

#include <cstdio>

// Valiant has 64 MB.
// EVK claims to have 64MB as well, but seems to wrap at 32MB.
// Leave 1MB for a fixed pattern test.
#define SDRAM_SIZE (30 << 20)

uint8_t sdram[SDRAM_SIZE] __attribute__((section(".sdram_bss,\"aw\",%nobits @")));
const uint8_t sdram_pattern[128] __attribute__((section(".sdram_data"))) = {
    0x00, 0x01, 0x02, 0x03, 0x04, 0x05, 0x06, 0x07, 0x08, 0x09, 0x0A, 0x0B, 0x0C, 0x0D, 0x0E, 0x0F,
    0x00, 0x01, 0x02, 0x03, 0x04, 0x05, 0x06, 0x07, 0x08, 0x09, 0x0A, 0x0B, 0x0C, 0x0D, 0x0E, 0x0F,
    0x00, 0x01, 0x02, 0x03, 0x04, 0x05, 0x06, 0x07, 0x08, 0x09, 0x0A, 0x0B, 0x0C, 0x0D, 0x0E, 0x0F,
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    0x00, 0x01, 0x02, 0x03, 0x04, 0x05, 0x06, 0x07, 0x08, 0x09, 0x0A, 0x0B, 0x0C, 0x0D, 0x0E, 0x0F,
};
const uint8_t ocram_pattern[128] = {
    0x00, 0x01, 0x02, 0x03, 0x04, 0x05, 0x06, 0x07, 0x08, 0x09, 0x0A, 0x0B, 0x0C, 0x0D, 0x0E, 0x0F,
    0x00, 0x01, 0x02, 0x03, 0x04, 0x05, 0x06, 0x07, 0x08, 0x09, 0x0A, 0x0B, 0x0C, 0x0D, 0x0E, 0x0F,
    0x00, 0x01, 0x02, 0x03, 0x04, 0x05, 0x06, 0x07, 0x08, 0x09, 0x0A, 0x0B, 0x0C, 0x0D, 0x0E, 0x0F,
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    0x00, 0x01, 0x02, 0x03, 0x04, 0x05, 0x06, 0x07, 0x08, 0x09, 0x0A, 0x0B, 0x0C, 0x0D, 0x0E, 0x0F,
};

extern "C" void app_main(void *param) {
    printf("SDRAMTest\r\n");
    bool success = true;
    for (size_t i = 0; i < SDRAM_SIZE; ++i) {
        uint8_t val = i & 0xFF;
        if ((i % (1 << 20)) == 0) {
            printf("Writing to memory at %p\r\n", (sdram + i));
        }
        sdram[i] = val;
    }
    for (size_t i = 0; i < SDRAM_SIZE; ++i) {
        uint8_t val = i & 0xFF;
        if ((i % (1 << 20)) == 0) {
            printf("Reading from memory at %p\r\n", (sdram + i));
        }
        if (sdram[i] != val) {
            printf("Failed generated comparison at %p: 0x%x != 0x%x\r\n", (sdram + i), sdram[i], val);
            success = false;
            break;
        }
    }

    for (size_t i = 0; i < sizeof(ocram_pattern); ++i) {
        if (sdram_pattern[i] != ocram_pattern[i]) {
            printf("Failed fixed comparison at %p: 0x%x != 0x%x\r\n", &sdram_pattern[i], sdram_pattern[i], ocram_pattern[i]);
            success = false;
            break;
        }
    }

    if (success) {
        printf("SDRAMTest success!\r\n");
    }

    while (true) {
        taskYIELD();
    }
}
